## main/Kconfig
```kconfig
menu "ESP32 Wi-Fi Penetration Tool Configuration"

    config MGMT_AP_SSID
        string "Management AP SSID"
        default "tung tung tung sahur"
        help
            SSID for the management access point

    config MGMT_AP_PASSWORD
        string "Management AP Password"
        default "skibidi123"
        help
            Password for the management access point (min 8 characters)

    config MGMT_AP_MAX_CONNECTIONS
        int "Maximum connections to Management AP"
        default 4
        range 1 10
        help
            Maximum number of clients that can connect to the management AP

    config ATTACK_DEFAULT_TIMEOUT
        int "Default attack timeout (seconds)"
        default 60
        range 10 300
        help
            Default timeout value for attacks in seconds

    config ENABLE_DEBUG_UTILS
        bool "Enable debug utilities"
        default y
        help
            Enable debug utilities like memory tracking and hexdump

    config WEB_MOUNT_POINT
        string "Website mount point in SPIFFS"
        default "/www"
        help
            Mount point for website files if using SPIFFS

endmenu
```

## sdkconfig.defaults
```kconfig
############################################
# ESP32 Wi-Fi Penetration Tool
# Project Configuration
############################################

# Wi-Fi Configuration
CONFIG_ESP32_WIFI_NVS_ENABLED=n
CONFIG_ESP32_WIFI_STATIC_RX_BUFFER_NUM=16
CONFIG_ESP32_WIFI_DYNAMIC_RX_BUFFER_NUM=32
CONFIG_ESP32_WIFI_TX_BUFFER_TYPE=1
CONFIG_ESP32_WIFI_DYNAMIC_TX_BUFFER_NUM=32

# Management AP Configuration
CONFIG_MGMT_AP_SSID="tung tung tung sahur"
CONFIG_MGMT_AP_PASSWORD="skibidi123"
CONFIG_MGMT_AP_MAX_CONNECTIONS=4

# Logging Configuration
CONFIG_LOG_DEFAULT_LEVEL_INFO=y
CONFIG_LOG_MAXIMUM_LEVEL_VERBOSE=y

# HTTP Server Configuration
CONFIG_HTTPD_MAX_REQ_HDR_LEN=1024
CONFIG_HTTPD_MAX_URI_LEN=512

# Task Watchdog
CONFIG_ESP_TASK_WDT=y
CONFIG_ESP_TASK_WDT_PANIC=y
CONFIG_ESP_TASK_WDT_TIMEOUT_S=5
```
